#include "config.h"
#include "nhl_logos.h"

#include "team_logos.h"

// Team-logo drawing with a single-slot RAM cache. Logos are 64x64 RGB565
// PROGMEM bitmaps (team_logos.h, generated by tools/gen_team_logos.py from
// the NHL SVG set) with 0x1909 as the transparent sentinel.

namespace {

struct LogoEntry {
  const char* abbrev;
  const uint16_t* data;
};
const LogoEntry kLogos[] = {
  {"ANA", LOGO_64_ANA}, {"BOS", LOGO_64_BOS}, {"BUF", LOGO_64_BUF},
  {"CGY", LOGO_64_CGY}, {"CAR", LOGO_64_CAR}, {"CHI", LOGO_64_CHI},
  {"COL", LOGO_64_COL}, {"CBJ", LOGO_64_CBJ}, {"DAL", LOGO_64_DAL},
  {"DET", LOGO_64_DET}, {"EDM", LOGO_64_EDM}, {"FLA", LOGO_64_FLA},
  {"LAK", LOGO_64_LAK}, {"MIN", LOGO_64_MIN}, {"MTL", LOGO_64_MTL},
  {"NSH", LOGO_64_NSH}, {"NJD", LOGO_64_NJD}, {"NYI", LOGO_64_NYI},
  {"NYR", LOGO_64_NYR}, {"OTT", LOGO_64_OTT}, {"PHI", LOGO_64_PHI},
  {"PIT", LOGO_64_PIT}, {"SJS", LOGO_64_SJS}, {"SEA", LOGO_64_SEA},
  {"STL", LOGO_64_STL}, {"TBL", LOGO_64_TBL}, {"TOR", LOGO_64_TOR},
  {"UTA", LOGO_64_UTA}, {"VAN", LOGO_64_VAN}, {"VGK", LOGO_64_VGK},
  {"WSH", LOGO_64_WSH}, {"WPG", LOGO_64_WPG},
};

const uint16_t* logoFor(const char* abbrev) {
  if (abbrev == nullptr || abbrev[0] == '\0') return nullptr;
  for (const LogoEntry& e : kLogos) {
    if (strcmp(e.abbrev, abbrev) == 0) return e.data;
  }
  return nullptr;
}

// Single-slot cache: the live screen shows one game (two logos), and the
// waiting screen redraws its card rarely, so a 8 KB slot beats an LRU.
uint16_t* cachePixels = nullptr;
char cacheAbb[4] = "";

const uint16_t* cachedLogo(const char* abbrev) {
  if (strcmp(cacheAbb, abbrev) == 0 && cachePixels != nullptr) {
    return cachePixels;
  }
  const uint16_t* src = logoFor(abbrev);
  if (src == nullptr) return nullptr;
  if (cachePixels == nullptr) {
    cachePixels = new uint16_t[64 * 64];
    if (cachePixels == nullptr) return nullptr;
  }
  memcpy_P(cachePixels, src, 64 * 64 * sizeof(uint16_t));
  strlcpy(cacheAbb, abbrev, sizeof(cacheAbb));
  return cachePixels;
}

void drawFallbackBadge(Adafruit_GFX& target, int x, int y, const char* abbrev) {
  target.fillRoundRect(x, y, 64, 64, 8, COLOR_CARD);
  target.drawRoundRect(x, y, 64, 64, 8, COLOR_MUTED);
  target.setTextColor(COLOR_MUTED);
  target.setTextSize(2);
  target.setCursor(x + 14, y + 24);
  target.print(abbrev[0] ? abbrev : "?");
}

void blit(Adafruit_GFX& target, int x, int y, const uint16_t* px, int step) {
  for (int row = 0; row < 64; row += step) {
    for (int col = 0; col < 64; col += step) {
      uint16_t c = px[row * 64 + col];
      if (c == 0x1909) continue;
      if (step == 1) target.drawPixel(x + col, y + row, c);
      else target.fillRect(x + col * 1, y + row, 0, 0, c);  // placeholder
    }
  }
}

}  // namespace

void ensureLogoCached(int teamId, const char* abbrev) {
  (void)teamId;
  if (abbrev != nullptr) (void)cachedLogo(abbrev);
}

void drawTeamLogo64(Adafruit_GFX& target, int x, int y, int teamId,
                    const char* abbrev) {
  (void)teamId;
  const uint16_t* px = abbrev ? cachedLogo(abbrev) : nullptr;
  if (px == nullptr) {
    drawFallbackBadge(target, x, y, abbrev ? abbrev : "?");
    return;
  }
  for (int row = 0; row < 64; ++row)
    for (int col = 0; col < 64; ++col) {
      uint16_t c = px[row * 64 + col];
      if (c != 0x1909) target.drawPixel(x + col, y + row, c);
    }
}

void drawTeamLogoScaled(Adafruit_GFX& target, int x, int y, int teamId,
                        const char* abbrev, int size) {
  (void)teamId;
  if (size == 64) {
    drawTeamLogo64(target, x, y, teamId, abbrev);
    return;
  }
  const uint16_t* px = abbrev ? cachedLogo(abbrev) : nullptr;
  if (px == nullptr) {
    drawFallbackBadge(target, x, y, abbrev ? abbrev : "?");
    return;
  }
  int step = 64 / size;  // nearest-neighbor sample
  int cell = (size + 63) / 64 + 1;  // >=1 px cell per source pixel
  for (int row = 0; row < 64; row += step)
    for (int col = 0; col < 64; col += step) {
      uint16_t c = px[row * 64 + col];
      if (c == 0x1909) continue;
      target.fillRect(x + (col / step) * (64 / size),
                      y + (row / step) * (64 / size), 64 / size, 64 / size, c);
    }
  (void)cell;
}
